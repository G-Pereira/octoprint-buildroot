## package/Config.in
```kconfig
source "$BR2_EXTERNAL_OCTOPRINT_PATH/package/python-blinker/Config.in"
source "$BR2_EXTERNAL_OCTOPRINT_PATH/package/python-cachelib/Config.in"
source "$BR2_EXTERNAL_OCTOPRINT_PATH/package/python-emoji/Config.in"
source "$BR2_EXTERNAL_OCTOPRINT_PATH/package/python-feedparser/Config.in"
source "$BR2_EXTERNAL_OCTOPRINT_PATH/package/python-filetype/Config.in"
source "$BR2_EXTERNAL_OCTOPRINT_PATH/package/python-flask-assets/Config.in"
source "$BR2_EXTERNAL_OCTOPRINT_PATH/package/python-frozendict/Config.in"
source "$BR2_EXTERNAL_OCTOPRINT_PATH/package/python-octoprint/Config.in"
source "$BR2_EXTERNAL_OCTOPRINT_PATH/package/python-octoprint-filecheck/Config.in"
source "$BR2_EXTERNAL_OCTOPRINT_PATH/package/python-octoprint-firmwarecheck/Config.in"
source "$BR2_EXTERNAL_OCTOPRINT_PATH/package/python-octoprint-pisupport/Config.in"
source "$BR2_EXTERNAL_OCTOPRINT_PATH/package/python-pkginfo/Config.in"
source "$BR2_EXTERNAL_OCTOPRINT_PATH/package/python-pyserial/Config.in"
source "$BR2_EXTERNAL_OCTOPRINT_PATH/package/python-sarge/Config.in"
source "$BR2_EXTERNAL_OCTOPRINT_PATH/package/python-unidecode/Config.in"
source "$BR2_EXTERNAL_OCTOPRINT_PATH/package/python-webassets/Config.in"
source "$BR2_EXTERNAL_OCTOPRINT_PATH/package/python-zipstream-ng/Config.in"
```

## package/python-emoji/Config.in
```kconfig
config BR2_PACKAGE_PYTHON_EMOJI
	bool "python-emoji"
	help
	  Emoji for Python.

	  https://github.com/carpedm20/emoji/
```

## package/python-filetype/Config.in
```kconfig
config BR2_PACKAGE_PYTHON_FILETYPE
	bool "python-filetype"
	help
	  Infer file type and MIME type of any file/buffer. No
	  external dependencies.

	  https://github.com/h2non/filetype.py
```

## package/python-flask-assets/Config.in
```kconfig
config BR2_PACKAGE_PYTHON_FLASK_ASSETS
	bool "python-flask-assets"
	select BR2_PACKAGE_PYTHON_FLASK # runtime
	select BR2_PACKAGE_PYTHON_WEBASSETS # runtime
	help
	  Asset management for Flask, to compress and merge CSS and
	  Javascript files.

	  http://github.com/miracle2k/flask-assets
```

## package/python-flask-babel/Config.in
```kconfig
config BR2_PACKAGE_PYTHON_FLASK_BABEL
	bool "python-flask-babel"
	select BR2_PACKAGE_PYTHON_BABEL # runtime
	select BR2_PACKAGE_PYTHON_FLASK # runtime
	select BR2_PACKAGE_PYTHON_JINJA2 # runtime
	select BR2_PACKAGE_PYTHON_PYTZ # runtime
	help
	  Adds i18n/l10n support to Flask applications.

	  http://github.com/python-babel/flask-babel
```

## package/python-flask-login/Config.in
```kconfig
config BR2_PACKAGE_PYTHON_FLASK_LOGIN
	bool "python-flask-login"
	select BR2_PACKAGE_PYTHON_FLASK # runtime
	select BR2_PACKAGE_PYTHON_WERKZEUG # runtime
	help
	  User authentication and session management for Flask.

	  https://github.com/maxcountryman/flask-login
```

## package/python-flask/Config.in
```kconfig
config BR2_PACKAGE_PYTHON_FLASK
	bool "python-flask"
	select BR2_PACKAGE_PYTHON_CLICK # runtime
	select BR2_PACKAGE_PYTHON_IMPORTLIB_METADATA # runtime
	select BR2_PACKAGE_PYTHON_ITSDANGEROUS # runtime
	select BR2_PACKAGE_PYTHON_JINJA2 # runtime
	select BR2_PACKAGE_PYTHON_WERKZEUG # runtime
	help
	  A simple framework for building complex web applications.

	  https://palletsprojects.com/p/flask
```

## package/python-frozendict/Config.in
```kconfig
config BR2_PACKAGE_PYTHON_FROZENDICT
	bool "python-frozendict"
	help
	  A simple immutable dictionary.

	  https://github.com/Marco-Sulla/python-frozendict
```

## package/python-importlib-resources/Config.in
```kconfig
config BR2_PACKAGE_PYTHON_IMPORTLIB_RESOURCES
	bool "python-importlib-resources"
	select BR2_PACKAGE_PYTHON_ZIPP # runtime
	help
	  importlib_resources is a backport of Python standard library importlib.resources module for older Pythons.

	  https://github.com/python/importlib_resources
```

## package/python-itsdangerous/Config.in
```kconfig
config BR2_PACKAGE_PYTHON_ITSDANGEROUS
	bool "python-itsdangerous"
	help
	  Safely pass data to untrusted environments and back.

	  https://palletsprojects.com/p/itsdangerous/
```

## package/python-jinja2/Config.in
```kconfig
config BR2_PACKAGE_PYTHON_JINJA2
	bool "python-jinja2"
	select BR2_PACKAGE_PYTHON_MARKUPSAFE # runtime
	help
	  A very fast and expressive template engine.

	  https://palletsprojects.com/p/jinja/
```

## package/python-markdown/Config.in
```kconfig
config BR2_PACKAGE_PYTHON_MARKDOWN
	bool "python-markdown"
	select BR2_PACKAGE_PYTHON_IMPORTLIB_METADATA # runtime
	help
	  Python implementation of Markdown.

	  https://Python-Markdown.github.io/
```

## package/python-markupsafe/Config.in
```kconfig
config BR2_PACKAGE_PYTHON_MARKUPSAFE
	bool "python-markupsafe"
	help
	  Safely add untrusted strings to HTML/XML markup.

	  https://palletsprojects.com/p/markupsafe/
```

## package/python-netaddr/Config.in
```kconfig
config BR2_PACKAGE_PYTHON_NETADDR
	bool "python-netaddr"
	select BR2_PACKAGE_PYTHON_IMPORTLIB_RESOURCES # runtime
	help
	  A network address manipulation library for Python.

	  https://github.com/drkjam/netaddr/
```

## package/python-netifaces/Config.in
```kconfig
config BR2_PACKAGE_PYTHON_NETIFACES
	bool "python-netifaces"
	help
	  Portable network interface information.

	  https://github.com/al45tair/netifaces
```

## package/python-octoprint-filecheck/Config.in
```kconfig
config BR2_PACKAGE_PYTHON_OCTOPRINT_FILECHECK
	bool "python-octoprint-filecheck"
	help
	  Checks for common issues in uploaded files.

	  https://github.com/OctoPrint/OctoPrint-FileCheck
```

## package/python-octoprint-firmwarecheck/Config.in
```kconfig
config BR2_PACKAGE_PYTHON_OCTOPRINT_FIRMWARECHECK
	bool "python-octoprint-firmwarecheck"
	help
	  Checks for unsafe or broken printer firmwares.

	  https://github.com/OctoPrint/OctoPrint-FirmwareCheck
```

## package/python-octoprint-pisupport/Config.in
```kconfig
config BR2_PACKAGE_PYTHON_OCTOPRINT_PISUPPORT
	bool "python-octoprint-pisupport"
	help
	  Provides additional information about your Pi in the UI.

	  https://github.com/OctoPrint/OctoPrint-PiSupport
```

## package/python-octoprint/Config.in
```kconfig
config BR2_PACKAGE_PYTHON_OCTOPRINT
	bool "python-octoprint"
	select BR2_PACKAGE_PYTHON_BLINKER # runtime
	select BR2_PACKAGE_PYTHON_CACHELIB # runtime
	select BR2_PACKAGE_PYTHON_CLICK # runtime
	select BR2_PACKAGE_PYTHON_COLORLOG # runtime
	select BR2_PACKAGE_PYTHON_EMOJI # runtime
	select BR2_PACKAGE_PYTHON_FILETYPE # runtime
	select BR2_PACKAGE_PYTHON_FEEDPARSER # runtime
	select BR2_PACKAGE_PYTHON_FLASK # runtime
	select BR2_PACKAGE_PYTHON_FLASK_ASSETS # runtime
	select BR2_PACKAGE_PYTHON_FLASK_BABEL # runtime
	select BR2_PACKAGE_PYTHON_FLASK_LOGIN # runtime
	select BR2_PACKAGE_PYTHON_FROZENDICT # runtime
	select BR2_PACKAGE_PYTHON_FUTURE # runtime
	select BR2_PACKAGE_PYTHON_MARKDOWN # runtime
	select BR2_PACKAGE_PYTHON_NETADDR # runtime
	select BR2_PACKAGE_PYTHON_NETIFACES # runtime
	select BR2_PACKAGE_PYTHON_OCTOPRINT_FILECHECK # runtime
	select BR2_PACKAGE_PYTHON_OCTOPRINT_FIRMWARECHECK # runtime
	select BR2_PACKAGE_PYTHON_OCTOPRINT_PISUPPORT # runtime
	select BR2_PACKAGE_PYTHON_PATHVALIDATE # runtime
	select BR2_PACKAGE_PYTHON_PKGINFO # runtime
	select BR2_PACKAGE_PYTHON_PSUTIL # runtime
	select BR2_PACKAGE_PYTHON_PYLRU # runtime
	select BR2_PACKAGE_PYTHON_PYSERIAL # runtime
	select BR2_PACKAGE_PYTHON_PYYAML # runtime
	select BR2_PACKAGE_PYTHON_REQUESTS # runtime
	select BR2_PACKAGE_PYTHON_REGEX # runtime
	select BR2_PACKAGE_PYTHON_SARGE # runtime
	select BR2_PACKAGE_PYTHON_SGMLLIB3K # runtime
	select BR2_PACKAGE_PYTHON_SEMANTIC_VERSION # runtime
	select BR2_PACKAGE_PYTHON_SENTRY_SDK # runtime
	select BR2_PACKAGE_PYTHON_TORNADO # runtime
	select BR2_PACKAGE_PYTHON_UNIDECODE # runtime
	select BR2_PACKAGE_PYTHON_WATCHDOG # runtime
	select BR2_PACKAGE_PYTHON_WEBSOCKET_CLIENT # runtime
	select BR2_PACKAGE_PYTHON_WERKZEUG # runtime
	select BR2_PACKAGE_PYTHON_WRAPT # runtime
	select BR2_PACKAGE_PYTHON_ZEROCONF # runtime
	select BR2_PACKAGE_PYTHON_ZIPSTREAM_NG # runtime
	help
	  The snappy web interface for your 3D printer.

	  https://octoprint.org
```

## package/python-psutil/Config.in
```kconfig
config BR2_PACKAGE_PYTHON_PSUTIL
	bool "python-psutil"
	help
	  Cross-platform lib for process and system monitoring in
	  Python.

	  https://github.com/giampaolo/psutil
```

## package/python-pyyaml/Config.in
```kconfig
config BR2_PACKAGE_PYTHON_PYYAML
	bool "python-pyyaml"
	help
	  YAML parser and emitter for Python.

	  https://pyyaml.org/
```

## package/python-sarge/Config.in
```kconfig
config BR2_PACKAGE_PYTHON_SARGE
	bool "python-sarge"
	help
	  A wrapper for subprocess which provides command pipeline
	  functionality.

	  https://docs.red-dove.com/sarge/
```

## package/python-unicode/Config.in
```kconfig
config BR2_PACKAGE_PYTHON_UNICODE
	bool "python-unicode"
	help
	  Display unicode character properties.

	  http://kassiopeia.juls.savba.sk/~garabik/software/unicode.html
```

## package/python-watchdog/Config.in
```kconfig
config BR2_PACKAGE_PYTHON_WATCHDOG
	bool "python-watchdog"
	help
	  Filesystem events monitoring.

	  https://github.com/gorakhargosh/watchdog
```
