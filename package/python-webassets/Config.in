## package/python-webassets/Config.in
```kconfig
config BR2_PACKAGE_PYTHON_WEBASSETS
	bool "python-webassets"
	help
	  Media asset management for Python, with glue code for
	  various web frameworks.

	  http://github.com/miracle2k/webassets/
```

## package/python-websocket-client/Config.in
```kconfig
config BR2_PACKAGE_PYTHON_WEBSOCKET_CLIENT
	bool "python-websocket-client"
	help
	  WebSocket client for Python with low level API options.

	  https://github.com/websocket-client/websocket-client.git
```

## package/python-werkzeug/Config.in
```kconfig
config BR2_PACKAGE_PYTHON_WERKZEUG
	bool "python-werkzeug"
	help
	  The comprehensive WSGI web application library.

	  https://palletsprojects.com/p/werkzeug/
```

## package/python-zipstream-new/Config.in
```kconfig
config BR2_PACKAGE_PYTHON_ZIPSTREAM_NEW
	bool "python-zipstream-new"
	help
	  Zipfile generator that takes input files as well as streams.

	  https://github.com/arjan-s/python-zipstream
```
